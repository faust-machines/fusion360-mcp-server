VERSION "OBD2 mode-01 subset — reference signals for CAN reverse engineering"

NS_ :

BS_:

BU_: Tester ECU

BO_ 2024 OBD2: 8 Tester
 SG_ length : 7|8@0+ (1,0) [0|8] "" Tester
 SG_ service M : 15|8@0+ (1,0) [0|255] "" Tester
 SG_ pid m65M : 23|8@0+ (1,0) [0|255] "" Tester
 SG_ S1_PID_04_EngineLoad m4 : 31|8@0+ (0.392156862745098,0) [0|100] "%" Tester
 SG_ S1_PID_05_CoolantTemp m5 : 31|8@0+ (1,-40) [-40|215] "degC" Tester
 SG_ S1_PID_0B_IntakeManifoldPressure m11 : 31|8@0+ (1,0) [0|255] "kPa" Tester
 SG_ S1_PID_0C_EngineRPM m12 : 31|16@0+ (0.25,0) [0|16383.75] "rpm" Tester
 SG_ S1_PID_0D_VehicleSpeed m13 : 31|8@0+ (1,0) [0|255] "km/h" Tester
 SG_ S1_PID_0F_IntakeAirTemp m15 : 31|8@0+ (1,-40) [-40|215] "degC" Tester
 SG_ S1_PID_10_MAFAirFlowRate m16 : 31|16@0+ (0.01,0) [0|655.35] "g/s" Tester
 SG_ S1_PID_11_ThrottlePosition m17 : 31|8@0+ (0.392156862745098,0) [0|100] "%" Tester
 SG_ S1_PID_2F_FuelLevel m47 : 31|8@0+ (0.392156862745098,0) [0|100] "%" Tester

CM_ BO_ 2024 "OBD2 mode-01 response (11-bit reply id 0x7E8). Extended-multiplexed by service (0x41) then pid.";
CM_ SG_ 2024 S1_PID_0C_EngineRPM "Engine speed";
CM_ SG_ 2024 S1_PID_0D_VehicleSpeed "Vehicle speed";

SG_MUL_VAL_ 2024 S1_PID_04_EngineLoad pid 4-4;
SG_MUL_VAL_ 2024 S1_PID_05_CoolantTemp pid 5-5;
SG_MUL_VAL_ 2024 S1_PID_0B_IntakeManifoldPressure pid 11-11;
SG_MUL_VAL_ 2024 S1_PID_0C_EngineRPM pid 12-12;
SG_MUL_VAL_ 2024 S1_PID_0D_VehicleSpeed pid 13-13;
SG_MUL_VAL_ 2024 S1_PID_0F_IntakeAirTemp pid 15-15;
SG_MUL_VAL_ 2024 S1_PID_10_MAFAirFlowRate pid 16-16;
SG_MUL_VAL_ 2024 S1_PID_11_ThrottlePosition pid 17-17;
SG_MUL_VAL_ 2024 S1_PID_2F_FuelLevel pid 47-47;
